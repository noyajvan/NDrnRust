## sdkconfig.defaults
```kconfig
# ESP-IDF sdkconfig defaults for ESP32-S3
CONFIG_IDF_TARGET="esp32s3"
CONFIG_FREERTOS_HZ=1000
CONFIG_ESPTOOLPY_FLASHMODE_QIO=y
CONFIG_ESPTOOLPY_FLASHFREQ_80M=y
CONFIG_ESPTOOLPY_FLASHSIZE_16MB=y
CONFIG_PARTITION_TABLE_OFFSET=0x8000
CONFIG_PARTITION_TABLE_TWO_OTA=y
CONFIG_ESP_SYSTEM_PANIC_PRINT_HALT=y
CONFIG_ESP_TASK_WDT=n
CONFIG_ESP_INT_WDT=n
CONFIG_ESP_WIFI_STATIC_RX_BUFFER_NUM=10
CONFIG_ESP_WIFI_DYNAMIC_RX_BUFFER_NUM=32
CONFIG_ESP_WIFI_STATIC_TX_BUFFER=4
CONFIG_ESP_WIFI_DYNAMIC_TX_BUFFER=y
CONFIG_LWIP_LOCAL_HOSTNAME="dropctrl-v3"
CONFIG_LWIP_MAX_SOCKETS=16
```
